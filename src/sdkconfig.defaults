## src/sdkconfig.defaults
```kconfig
CONFIG_BT_ENABLED=y
CONFIG_BTDM_CTRL_MODE_BTDM=y
CONFIG_BTDM_CTRL_HCI_MODE_VHCI=y
CONFIG_BT_BLUEDROID_ENABLED=y
CONFIG_BT_CLASSIC_ENABLED=y
CONFIG_BT_HID_HOST_ENABLED=y
CONFIG_BT_SPP_ENABLED=y

CONFIG_FREERTOS_SUPPORT_STATIC_ALLOCATION=y
CONFIG_FREERTOS_USE_TICKLESS_IDLE=y
#CONFIG_PM_ENABLE=y
CONFIG_ESP_TASK_WDT_PANIC=y

# enable uxTaskGetSystemState and vTaskList
CONFIG_FREERTOS_USE_TRACE_FACILITY=y
CONFIG_FREERTOS_GENERATE_RUN_TIME_STATS=y
# TODO: replace these functions!
CONFIG_FREERTOS_USE_STATS_FORMATTING_FUNCTIONS=y
CONFIG_FREERTOS_VTASKLIST_INCLUDE_COREID=y

# This is necessary for performance reasons. Without, the stream was not smooth at all
# and it seemed that the whole cpu was blocked (LOG lines paused in the middle).
#CONFIG_BTDM_CTRL_PINNED_TO_CORE_1=y
#CONFIG_BTDM_CTRL_PINNED_TO_CORE=1
```
